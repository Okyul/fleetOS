## firmware/main/Kconfig.projbuild
```kconfig
menu "FleetOS configuration"

    config FLEETOS_WIFI_SSID
        string "WiFi SSID"
        default ""
        help
            SSID of the WiFi network the device should join. Set via
            `idf.py menuconfig` (FleetOS configuration → WiFi SSID). Lives
            in sdkconfig, which is gitignored.

    config FLEETOS_WIFI_PASSWORD
        string "WiFi password"
        default ""
        help
            WPA2-PSK password for the SSID above. Empty for open networks.

    config FLEETOS_MQTT_BROKER_URI
        string "MQTT broker URI"
        default "mqtts://"
        help
            HiveMQ Cloud broker URI. Format: mqtts://<cluster-id>.s1.eu.hivemq.cloud:8883
            Must use mqtts:// (TLS); HiveMQ Cloud does not accept plain MQTT.

    config FLEETOS_MQTT_USERNAME
        string "MQTT username"
        default ""
        help
            HiveMQ Cloud access credential username (set in HiveMQ console
            under Access Management).

    config FLEETOS_MQTT_PASSWORD
        string "MQTT password"
        default ""
        help
            HiveMQ Cloud access credential password.

endmenu
```

## firmware/sdkconfig.defaults
```kconfig
# Shareable build defaults. Loaded by ESP-IDF before merging in user-set
# sdkconfig values. NEVER put secrets here — secrets go in sdkconfig (gitignored)
# via Kconfig.projbuild prompts.

# 4 MB flash — board has 4 MB; default is 2 MB which fits today's blink but
# leaves no room for two OTA app slots on Day 3.
CONFIG_ESPTOOLPY_FLASHSIZE_4MB=y
CONFIG_ESPTOOLPY_FLASHSIZE="4MB"

# Use the bundled CA cert store for TLS — covers Let's Encrypt (HiveMQ Cloud)
# and Cloudflare R2's certs (Day 3 OTA downloads). Avoids pinning a specific
# root that could rotate.
CONFIG_MBEDTLS_CERTIFICATE_BUNDLE=y
CONFIG_MBEDTLS_CERTIFICATE_BUNDLE_DEFAULT_FULL=y

# Custom partition table for OTA: two ota_0/ota_1 app slots, no factory.
# See firmware/partitions.csv for the layout.
CONFIG_PARTITION_TABLE_CUSTOM=y
CONFIG_PARTITION_TABLE_CUSTOM_FILENAME="partitions.csv"
CONFIG_PARTITION_TABLE_FILENAME="partitions.csv"

# OTA rollback safety. With this enabled, the bootloader marks freshly-OTA'd
# images as PENDING_VERIFY on first boot. The app MUST call
# esp_ota_mark_app_valid_cancel_rollback() to confirm it's healthy, or a
# subsequent reboot will revert to the previous good slot. We wire that
# confirmation to "MQTT connected + first alive published successfully" in
# mqtt.c, and a watchdog task in ota.c reboots after 60s if that never
# happens — so a borked OTA gets auto-reverted, no bricks.
CONFIG_BOOTLOADER_APP_ROLLBACK_ENABLE=y
```
